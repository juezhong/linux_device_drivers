/*
 * Copyright 2019 NXP
 *
 * This program is free software; you can redistribute it and/or
 * modify it under the terms of the GNU General Public License
 * as published by the Free Software Foundation; either version 2
 * of the License, or (at your option) any later version.
 */

#include "imx6ull-14x14-evk.dts"

&usdhc2 {
	pinctrl-names = "default", "state_100mhz", "state_200mhz";
	pinctrl-0 = <&pinctrl_usdhc2_8bit>;
	pinctrl-1 = <&pinctrl_usdhc2_8bit_100mhz>;
	pinctrl-2 = <&pinctrl_usdhc2_8bit_200mhz>;
	bus-width = <8>;
	non-removable;
	status = "okay";
};

// 根节点下添加节点，会与 dtsi 以及其他 include 的文件合并在一起
/ {
	opendev_led {
		compatible = "opendev-led";
		status = "disabled";

		#address-cells = <0x01>;
		#size-cells = <0x00>;

		reg = <
			0x020C406C 0x04 /* CCM_CCGR1_BASE */
			0x020E0068 0x04 /* SW_MUX_GPIO1_IO03_BASE */
			0x020E02F4 0x04 /* SW_PAD_GPIO1_IO03_BASE */
			0x0209C000 0x04 /* GPIO1_DR_BASE */
			0x0209C004 0x04 /* GPIO1_GDIR_BASE */
		>;
	};
};
